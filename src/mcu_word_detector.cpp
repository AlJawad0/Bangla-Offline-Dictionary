#include "mcu_word_detector.h"

#include <algorithm>
#include <cstring>

#include "esp_heap_caps.h"

namespace ocr_demo {
namespace {

// Fixed-point port of esp32s3_word_detection_colab_fixed.py.
// No float/double calculations are used in the detector data path.
constexpr int kBgBlurRadius = 31;
constexpr uint16_t kCharMinArea = 15;
constexpr size_t kComponentStackCapacity = 65536;
constexpr int kMaxKernelRadius = 96;
constexpr int kMaxKernelTaps = 2 * kMaxKernelRadius + 1;
constexpr uint32_t kQ15One = 32768U;

// exp(-t) in Q15 for t=index/1024, 0<=t<=4.5.
// The finer LUT plus Q12 sigma keeps the adaptive word Gaussian close to FP32
// while all runtime arithmetic remains integer.
static const uint16_t kExpNegQ15[4609] = {
    32768, 32736, 32704, 32672, 32640, 32608, 32577, 32545, 32513, 32481, 32450, 32418,
    32386, 32355, 32323, 32291, 32260, 32228, 32197, 32166, 32134, 32103, 32072, 32040,
    32009, 31978, 31946, 31915, 31884, 31853, 31822, 31791, 31760, 31729, 31698, 31667,
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    364,
};

// ---------------------------------------------------------------------------
// Small helpers
// ---------------------------------------------------------------------------

template <typename T>
T* AllocatePsram(size_t count) {
  const size_t bytes = count * sizeof(T);
  void* p = heap_caps_malloc(bytes, MALLOC_CAP_SPIRAM | MALLOC_CAP_8BIT);
  if (p == nullptr) p = heap_caps_malloc(bytes, MALLOC_CAP_8BIT);
  return static_cast<T*>(p);
}

inline int ClampInt(int value, int low, int high) {
  if (value < low) return low;
  if (value > high) return high;
  return value;
}

inline int ClampIndex(int value, int high) { return ClampInt(value, 0, high); }

inline uint32_t DivRoundNearestU64(uint64_t numerator, uint64_t denominator) {
  return denominator == 0 ? 0U
                          : static_cast<uint32_t>((numerator + denominator / 2U) / denominator);
}

inline int CeilDivPositive(int numerator, int denominator) {
  return (numerator + denominator - 1) / denominator;
}

// Character component recorded by the first pass. `seed` lets a component be
// re-flooded and erased from the ink mask later, once the median character
// height is known and the component can be judged oversized.
struct CharBox {
  uint16_t x1;
  uint16_t y1;
  uint16_t x2;
  uint16_t y2;
  uint32_t area;
  uint32_t seed;
};

inline int CharCenterX(const CharBox& b) { return (b.x1 + b.x2) >> 1; }
inline int CharCenterY(const CharBox& b) { return (b.y1 + b.y2) >> 1; }

// ---------------------------------------------------------------------------
// Gaussian kernels (Q15 taps, Q12 sigma, integer only)
// ---------------------------------------------------------------------------

bool GaussianKernelQ15(uint32_t sigma_q12, int radius, uint16_t* kernel) {
  if (sigma_q12 == 0 || radius < 0 || radius > kMaxKernelRadius || kernel == nullptr) {
    return false;
  }
  const int taps = 2 * radius + 1;
  const uint64_t sigma2 = static_cast<uint64_t>(sigma_q12) * sigma_q12;
  uint32_t raw_sum = 0;

  for (int i = 0; i < taps; ++i) {
    const int x = i - radius;
    const uint64_t ax = static_cast<uint64_t>(x < 0 ? -x : x);
    const uint64_t x2 = ax * ax;
    // exp(-x^2 / (2 sigma^2)); the LUT index is t*1024 with t = x^2/(2 sigma^2).
    uint32_t lut_index = DivRoundNearestU64(x2 * 8589934592ULL, sigma2);
    if (lut_index > 4608U) lut_index = 4608U;
    kernel[i] = kExpNegQ15[lut_index];
    raw_sum += kernel[i];
  }
  if (raw_sum == 0) return false;

  uint32_t normalized_sum = 0;
  for (int i = 0; i < taps; ++i) {
    kernel[i] = static_cast<uint16_t>(
        DivRoundNearestU64(static_cast<uint64_t>(kernel[i]) * kQ15One, raw_sum));
    normalized_sum += kernel[i];
  }

  const int32_t correction =
      static_cast<int32_t>(kQ15One) - static_cast<int32_t>(normalized_sum);
  const int32_t fixed_center = static_cast<int32_t>(kernel[radius]) + correction;
  if (fixed_center < 0 || fixed_center > 65535) return false;
  kernel[radius] = static_cast<uint16_t>(fixed_center);
  return true;
}

inline int RadiusForSigmaQ12(uint32_t sigma_q12, int minimum) {
  const int radius = static_cast<int>((3U * sigma_q12 + 4095U) / 4096U);
  return std::max(minimum, radius);
}

// ---------------------------------------------------------------------------
// Stage 1: contrast measurement and adaptive threshold offset
// ---------------------------------------------------------------------------

// The fixed THRESH_C=12 of the original port assumes a well exposed page. A
// blurry, low contrast camera frame can have an ink-to-paper delta barely above
// 12, in which case the whole frame thresholds to nothing. Scaling the offset
// with the measured contrast keeps faint frames detectable while still
// rejecting sensor noise on crisp, high contrast frames.
uint8_t MeasureContrastAndThresholdC(const uint8_t* gray, size_t count,
                                     uint16_t* contrast_out) {
  uint32_t histogram[256] = {};
  for (size_t i = 0; i < count; ++i) ++histogram[gray[i]];

  // Paper level: the dominant bright mode.
  uint32_t best_count = 0;
  int paper = 255;
  for (int v = 64; v < 256; ++v) {
    if (histogram[v] > best_count) {
      best_count = histogram[v];
      paper = v;
    }
  }

  // Ink level: the 1st percentile of the intensity distribution.
  const uint32_t target = std::max<uint32_t>(1U, static_cast<uint32_t>(count / 100U));
  uint32_t accumulated = 0;
  int ink = paper;
  for (int v = 0; v < 256; ++v) {
    accumulated += histogram[v];
    if (accumulated >= target) {
      ink = v;
      break;
    }
  }

  const int contrast = std::max(0, paper - ink);
  if (contrast_out != nullptr) *contrast_out = static_cast<uint16_t>(contrast);
  return static_cast<uint8_t>(ClampInt(contrast / 12, 6, 18));
}

// ---------------------------------------------------------------------------
// Stage 2: local background and ink mask
// ---------------------------------------------------------------------------

// The background is smooth by construction, so estimating it on a decimated
// image and bilinearly expanding it is visually identical to the full
// resolution blur while costing dec^2 times fewer multiply-accumulates. That
// saving is what makes a large, text-size-adaptive background window
// affordable on the MCU.
void DecimateBoxAverage(const uint8_t* gray, int width, int height, int dec, uint8_t* small,
                        int small_width, int small_height) {
  for (int j = 0; j < small_height; ++j) {
    const int y0 = j * dec;
    const int y1 = std::min(y0 + dec, height);
    for (int i = 0; i < small_width; ++i) {
      const int x0 = i * dec;
      const int x1 = std::min(x0 + dec, width);
      uint32_t sum = 0;
      uint32_t samples = 0;
      for (int y = y0; y < y1; ++y) {
        const uint8_t* row = gray + static_cast<size_t>(y) * width;
        for (int x = x0; x < x1; ++x) {
          sum += row[x];
          ++samples;
        }
      }
      small[static_cast<size_t>(j) * small_width + i] =
          samples == 0 ? 255 : static_cast<uint8_t>(sum / samples);
    }
  }
}

void BlurSmallSeparable(uint8_t* small, int width, int height, uint16_t* scratch_q8,
                        const uint16_t* kernel, int radius) {
  const int taps = 2 * radius + 1;
  for (int y = 0; y < height; ++y) {
    const uint8_t* row = small + static_cast<size_t>(y) * width;
    uint16_t* out = scratch_q8 + static_cast<size_t>(y) * width;
    for (int x = 0; x < width; ++x) {
      uint32_t acc_q15 = 0;
      for (int i = 0; i < taps; ++i) {
        acc_q15 += static_cast<uint32_t>(row[ClampIndex(x + i - radius, width - 1)]) * kernel[i];
      }
      out[x] = static_cast<uint16_t>((acc_q15 + 64U) >> 7);  // Q8
    }
  }
  for (int y = 0; y < height; ++y) {
    for (int x = 0; x < width; ++x) {
      uint32_t acc_q23 = 0;
      for (int i = 0; i < taps; ++i) {
        const int sy = ClampIndex(y + i - radius, height - 1);
        acc_q23 +=
            static_cast<uint32_t>(scratch_q8[static_cast<size_t>(sy) * width + x]) * kernel[i];
      }
      const uint32_t q8 = (acc_q23 + (1U << 14)) >> 15;
      small[static_cast<size_t>(y) * width + x] =
          static_cast<uint8_t>(std::min<uint32_t>(q8 >> 8, 255U));
    }
  }
}

// Bilinear expansion coordinate of full-resolution index `p` on a grid whose
// sample j represents the block centred at full-resolution j*dec + (dec-1)/2.
inline int32_t ExpandCoordQ16(int p, int dec, int small_extent) {
  int32_t q16 = (static_cast<int32_t>(2 * p - (dec - 1)) * 32768) / dec;
  const int32_t high = static_cast<int32_t>(small_extent - 1) << 16;
  if (q16 < 0) q16 = 0;
  if (q16 > high) q16 = high;
  return q16;
}

bool BuildInkMask(const uint8_t* gray, uint8_t* ink, uint8_t* background_small,
                  uint16_t* scratch_q8, int width, int height, int dec, int full_radius,
                  uint8_t threshold_c, int32_t* coord_x_q16, int32_t* coord_y_q16) {
  const int small_width = CeilDivPositive(width, dec);
  const int small_height = CeilDivPositive(height, dec);
  const int small_radius = ClampInt(CeilDivPositive(full_radius, dec), 2, kMaxKernelRadius);
  const uint32_t sigma_q12 =
      std::max<uint32_t>(4096U, (static_cast<uint32_t>(small_radius) * 4096U) / 2U);

  uint16_t kernel[kMaxKernelTaps];
  if (!GaussianKernelQ15(sigma_q12, small_radius, kernel)) return false;

  DecimateBoxAverage(gray, width, height, dec, background_small, small_width, small_height);
  BlurSmallSeparable(background_small, small_width, small_height, scratch_q8, kernel,
                     small_radius);

  for (int x = 0; x < width; ++x) coord_x_q16[x] = ExpandCoordQ16(x, dec, small_width);
  for (int y = 0; y < height; ++y) coord_y_q16[y] = ExpandCoordQ16(y, dec, small_height);

  const int32_t threshold_q16 = static_cast<int32_t>(threshold_c) << 16;
  for (int y = 0; y < height; ++y) {
    const int32_t fy = coord_y_q16[y];
    const int j0 = fy >> 16;
    const int j1 = std::min(j0 + 1, small_height - 1);
    const uint32_t wy = static_cast<uint32_t>(fy & 0xFFFF);
    const uint32_t iwy = 65536U - wy;
    const uint8_t* top = background_small + static_cast<size_t>(j0) * small_width;
    const uint8_t* bottom = background_small + static_cast<size_t>(j1) * small_width;
    const uint8_t* gray_row = gray + static_cast<size_t>(y) * width;
    uint8_t* ink_row = ink + static_cast<size_t>(y) * width;

    for (int x = 0; x < width; ++x) {
      const int32_t fx = coord_x_q16[x];
      const int i0 = fx >> 16;
      const int i1 = std::min(i0 + 1, small_width - 1);
      const uint32_t wx = static_cast<uint32_t>(fx & 0xFFFF);
      const uint32_t iwx = 65536U - wx;

      const uint64_t upper =
          static_cast<uint64_t>(top[i0]) * iwx + static_cast<uint64_t>(top[i1]) * wx;
      const uint64_t lower =
          static_cast<uint64_t>(bottom[i0]) * iwx + static_cast<uint64_t>(bottom[i1]) * wx;
      const int32_t background_q16 = static_cast<int32_t>((upper * iwy + lower * wy) >> 16);
      const int32_t gray_q16 = static_cast<int32_t>(gray_row[x]) << 16;
      ink_row[x] =
          (background_q16 > threshold_q16 && gray_q16 < background_q16 - threshold_q16) ? 1 : 0;
    }
  }
  return true;
}

// ---------------------------------------------------------------------------
// Connected components
// ---------------------------------------------------------------------------

void EraseComponent(uint8_t* mask, int width, int height, uint32_t seed, uint32_t* stack,
                    size_t stack_capacity) {
  if (mask[seed] == 0) return;
  size_t stack_size = 0;
  stack[stack_size++] = seed;
  mask[seed] = 0;
  while (stack_size > 0) {
    const uint32_t index = stack[--stack_size];
    const int y = static_cast<int>(index) / width;
    const int x = static_cast<int>(index) - y * width;
    const int ny[4] = {y + 1, y - 1, y, y};
    const int nx[4] = {x, x, x + 1, x - 1};
    for (int n = 0; n < 4; ++n) {
      if (nx[n] < 0 || nx[n] >= width || ny[n] < 0 || ny[n] >= height) continue;
      const uint32_t neighbor = static_cast<uint32_t>(ny[n] * width + nx[n]);
      if (mask[neighbor] == 0) continue;
      mask[neighbor] = 0;
      if (stack_size < stack_capacity) stack[stack_size++] = neighbor;
    }
  }
}

struct CharPassResult {
  size_t count;
  size_t height_count;
  bool overflow;
  bool box_overflow;
};

// `work` is a destroyable copy of `ink`. Components smaller than the minimum
// character area are erased from `ink` immediately, so speckle noise cannot
// seed spurious word blobs during the merge.
CharPassResult CollectCharComponents(uint8_t* work, uint8_t* ink, int width, int height,
                                     uint32_t min_area, uint32_t* stack, size_t stack_capacity,
                                     CharBox* boxes, size_t box_capacity,
                                     uint32_t* height_histogram, size_t height_histogram_size) {
  CharPassResult out{0, 0, false, false};
  const size_t pixel_count = static_cast<size_t>(width) * height;

  for (size_t seed = 0; seed < pixel_count; ++seed) {
    if (work[seed] == 0) continue;

    size_t stack_size = 0;
    stack[stack_size++] = static_cast<uint32_t>(seed);
    work[seed] = 0;
    uint32_t area = 0;
    int min_x = width;
    int min_y = height;
    int max_x = 0;
    int max_y = 0;
    bool component_overflow = false;

    while (stack_size > 0) {
      const uint32_t index = stack[--stack_size];
      const int y = static_cast<int>(index) / width;
      const int x = static_cast<int>(index) - y * width;
      ++area;
      min_x = std::min(min_x, x);
      max_x = std::max(max_x, x);
      min_y = std::min(min_y, y);
      max_y = std::max(max_y, y);

      const int ny[4] = {y + 1, y - 1, y, y};
      const int nx[4] = {x, x, x + 1, x - 1};
      for (int n = 0; n < 4; ++n) {
        if (nx[n] < 0 || nx[n] >= width || ny[n] < 0 || ny[n] >= height) continue;
        const uint32_t neighbor = static_cast<uint32_t>(ny[n] * width + nx[n]);
        if (work[neighbor] == 0) continue;
        work[neighbor] = 0;
        if (stack_size < stack_capacity) {
          stack[stack_size++] = neighbor;
        } else {
          component_overflow = true;
        }
      }
    }

    if (component_overflow) {
      out.overflow = true;
      continue;
    }
    if (area < min_area) {
      EraseComponent(ink, width, height, static_cast<uint32_t>(seed), stack, stack_capacity);
      continue;
    }

    const size_t component_height = static_cast<size_t>(max_y - min_y + 1);
    if (component_height < height_histogram_size) {
      ++height_histogram[component_height];
      ++out.height_count;
    }
    if (out.count < box_capacity) {
      boxes[out.count++] =
          CharBox{static_cast<uint16_t>(min_x), static_cast<uint16_t>(min_y),
                  static_cast<uint16_t>(max_x), static_cast<uint16_t>(max_y), area,
                  static_cast<uint32_t>(seed)};
    } else {
      out.box_overflow = true;
    }
  }
  return out;
}

struct BlobBox {
  uint16_t x1;
  uint16_t y1;
  uint16_t x2;
  uint16_t y2;
  uint32_t area;
};

size_t CollectBlobs(uint8_t* mask, int width, int height, uint32_t min_area, uint32_t* stack,
                    size_t stack_capacity, BlobBox* boxes, size_t box_capacity,
                    bool* overflowed, bool* capacity_reached) {
  size_t count = 0;
  const size_t pixel_count = static_cast<size_t>(width) * height;

  for (size_t seed = 0; seed < pixel_count; ++seed) {
    if (mask[seed] == 0) continue;

    size_t stack_size = 0;
    stack[stack_size++] = static_cast<uint32_t>(seed);
    mask[seed] = 0;
    uint32_t area = 0;
    int min_x = width;
    int min_y = height;
    int max_x = 0;
    int max_y = 0;
    bool component_overflow = false;

    while (stack_size > 0) {
      const uint32_t index = stack[--stack_size];
      const int y = static_cast<int>(index) / width;
      const int x = static_cast<int>(index) - y * width;
      ++area;
      min_x = std::min(min_x, x);
      max_x = std::max(max_x, x);
      min_y = std::min(min_y, y);
      max_y = std::max(max_y, y);

      const int ny[4] = {y + 1, y - 1, y, y};
      const int nx[4] = {x, x, x + 1, x - 1};
      for (int n = 0; n < 4; ++n) {
        if (nx[n] < 0 || nx[n] >= width || ny[n] < 0 || ny[n] >= height) continue;
        const uint32_t neighbor = static_cast<uint32_t>(ny[n] * width + nx[n]);
        if (mask[neighbor] == 0) continue;
        mask[neighbor] = 0;
        if (stack_size < stack_capacity) {
          stack[stack_size++] = neighbor;
        } else {
          component_overflow = true;
        }
      }
    }

    if (component_overflow) {
      *overflowed = true;
      continue;
    }
    if (area < min_area) continue;
    if (count >= box_capacity) {
      *capacity_reached = true;
      continue;
    }
    boxes[count++] = BlobBox{static_cast<uint16_t>(min_x), static_cast<uint16_t>(min_y),
                             static_cast<uint16_t>(max_x), static_cast<uint16_t>(max_y), area};
  }
  return count;
}

uint16_t MedianHeightX2FromHistogram(const uint32_t* histogram, size_t histogram_size,
                                     size_t count) {
  if (histogram == nullptr || count == 0) return 0;
  const size_t rank_lo = (count - 1) / 2;
  const size_t rank_hi = count / 2;
  size_t seen = 0;
  uint16_t value_lo = 0;
  uint16_t value_hi = 0;
  bool have_lo = false;
  for (size_t h = 0; h < histogram_size; ++h) {
    const size_t next = seen + histogram[h];
    if (!have_lo && rank_lo < next) {
      value_lo = static_cast<uint16_t>(h);
      have_lo = true;
    }
    if (rank_hi < next) {
      value_hi = static_cast<uint16_t>(h);
      break;
    }
    seen = next;
  }
  return static_cast<uint16_t>(value_lo + value_hi);
}

// ---------------------------------------------------------------------------
// Skew estimation
// ---------------------------------------------------------------------------

// Handheld capture is never perfectly level. The anisotropic merge blur is only
// ~0.12*h tall, so a few degrees of tilt pull the far end of a long word out of
// the vertical support and split it. Measuring the baseline slope from
// neighbouring character centres lets the merge follow the text line instead.
int16_t EstimateSkewSlopeQ12(CharBox* boxes, size_t count, int char_height) {
  if (count < 8 || char_height <= 0) return 0;

  // Sorting by x bounds the right-neighbour search to a small window.
  std::sort(boxes, boxes + count, [](const CharBox& a, const CharBox& b) {
    const int ax = CharCenterX(a);
    const int bx = CharCenterX(b);
    if (ax != bx) return ax < bx;
    return a.y1 < b.y1;
  });

  const int max_dx = 3 * char_height;
  const int max_dy = std::max(2, (6 * char_height) / 10);
  // Slope histogram over [-0.1875, +0.1875] in steps of 1/512 (Q12 step 8).
  constexpr int kSlopeBins = 193;
  constexpr int kSlopeCenter = 96;
  uint16_t histogram[kSlopeBins] = {};
  uint32_t samples = 0;

  const size_t stride = count > 1200 ? (count / 1200) + 1 : 1;
  for (size_t i = 0; i < count; i += stride) {
    const int cx = CharCenterX(boxes[i]);
    const int cy = CharCenterY(boxes[i]);
    for (size_t j = i + 1; j < count; ++j) {
      const int dx = CharCenterX(boxes[j]) - cx;
      if (dx <= 0) continue;
      if (dx > max_dx) break;
      const int dy = CharCenterY(boxes[j]) - cy;
      if (dy > max_dy || dy < -max_dy) continue;
      const int slope_q12 = (dy * 4096) / dx;
      const int bin = kSlopeCenter + ((slope_q12 + (slope_q12 >= 0 ? 4 : -4)) / 8);
      if (bin >= 0 && bin < kSlopeBins) {
        ++histogram[bin];
        ++samples;
      }
      break;  // nearest right neighbour only
    }
  }

  if (samples < 8) return 0;
  const uint32_t rank = samples / 2;
  uint32_t seen = 0;
  int median_bin = kSlopeCenter;
  for (int b = 0; b < kSlopeBins; ++b) {
    seen += histogram[b];
    if (seen > rank) {
      median_bin = b;
      break;
    }
  }
  return static_cast<int16_t>(ClampInt((median_bin - kSlopeCenter) * 8, -737, 737));
}

// ---------------------------------------------------------------------------
// Word merge
// ---------------------------------------------------------------------------

// Max-pool decimation of the ink mask. The merge result is only used to group
// characters, never to place a box edge, so it can run coarse.
void DecimateInkMax(const uint8_t* ink, int width, int height, int dec, uint8_t* small,
                    int small_width, int small_height) {
  for (int j = 0; j < small_height; ++j) {
    const int y0 = j * dec;
    const int y1 = std::min(y0 + dec, height);
    uint8_t* out = small + static_cast<size_t>(j) * small_width;
    for (int i = 0; i < small_width; ++i) {
      const int x0 = i * dec;
      const int x1 = std::min(x0 + dec, width);
      uint8_t value = 0;
      for (int y = y0; y < y1 && !value; ++y) {
        const uint8_t* row = ink + static_cast<size_t>(y) * width;
        for (int x = x0; x < x1; ++x) {
          if (row[x]) {
            value = 1;
            break;
          }
        }
      }
      out[i] = value;
    }
  }
}

// Horizontal pass of the anisotropic merge blur. The row index is sheared along
// the measured baseline so the elongated kernel axis follows the text rather
// than the pixel grid.
void MergeHorizontalPass(const uint8_t* ink, uint16_t* out_q15, int width, int height,
                         const uint16_t* kernel, int radius, const int16_t* tap_row_offset) {
  const int taps = 2 * radius + 1;
  for (int y = 0; y < height; ++y) {
    uint16_t* out = out_q15 + static_cast<size_t>(y) * width;
    for (int x = 0; x < width; ++x) {
      uint32_t acc_q15 = 0;
      for (int i = 0; i < taps; ++i) {
        const int sx = ClampIndex(x + i - radius, width - 1);
        const int sy = ClampIndex(y + tap_row_offset[i], height - 1);
        if (ink[static_cast<size_t>(sy) * width + sx]) acc_q15 += kernel[i];
      }
      out[x] = static_cast<uint16_t>(std::min<uint32_t>(acc_q15, kQ15One));
    }
  }
}

inline uint16_t MergeVerticalAt(const uint16_t* horizontal, int width, int height, int x, int y,
                                const uint16_t* kernel, int radius) {
  const int taps = 2 * radius + 1;
  // Max is 32768 * 32768 = 1,073,741,824, so uint32 is safe.
  uint32_t acc_q30 = 0;
  for (int i = 0; i < taps; ++i) {
    const int sy = ClampIndex(y + i - radius, height - 1);
    acc_q30 += static_cast<uint32_t>(horizontal[static_cast<size_t>(sy) * width + x]) * kernel[i];
  }
  const uint32_t q15 = (acc_q30 + (1U << 14)) >> 15;
  return static_cast<uint16_t>(std::min<uint32_t>(q15, kQ15One));
}

// Builds the binary word mask in `map`.
//
// Two changes relative to the original port:
//   * the blurred response is written once into `map` instead of being computed
//     twice, once to find the peak and once to threshold;
//   * the threshold is a fraction of a per-text-line peak instead of the single
//     global frame peak. Under a global peak, one bold heading anywhere in the
//     frame raises the bar for every other line, which both drops faint lines
//     entirely and pulls the surviving contours inwards - a direct cause of
//     over-tight boxes.
bool BuildWordMask(const uint8_t* ink, uint8_t* map, uint16_t* horizontal, int width,
                   int height, uint16_t median_height_x2, int16_t slope_q12,
                   const DetectorConfig& config, uint16_t* row_peak) {
  const uint32_t pct_x = std::max<uint32_t>(1U, config.merge_sigma_x_pct);
  const uint32_t pct_y = std::max<uint32_t>(1U, config.merge_sigma_y_pct);
  const uint32_t sigma_x_q12 = std::max<uint32_t>(
      4096U, (static_cast<uint32_t>(median_height_x2) * pct_x * 2048U + 50U) / 100U);
  const uint32_t sigma_y_q12 = std::max<uint32_t>(
      2458U, (static_cast<uint32_t>(median_height_x2) * pct_y * 2048U + 50U) / 100U);

  const int radius_x = RadiusForSigmaQ12(sigma_x_q12, 3);
  const int radius_y = RadiusForSigmaQ12(sigma_y_q12, 2);
  if (radius_x > kMaxKernelRadius || radius_y > kMaxKernelRadius) return false;

  uint16_t kernel_x[kMaxKernelTaps];
  uint16_t kernel_y[kMaxKernelTaps];
  if (!GaussianKernelQ15(sigma_x_q12, radius_x, kernel_x) ||
      !GaussianKernelQ15(sigma_y_q12, radius_y, kernel_y)) {
    return false;
  }

  int16_t tap_row_offset[kMaxKernelTaps];
  for (int i = 0; i < 2 * radius_x + 1; ++i) {
    const int dx = i - radius_x;
    const int32_t shifted = static_cast<int32_t>(slope_q12) * dx;
    // Round to nearest, symmetric about zero, without relying on >> of negatives.
    tap_row_offset[i] = static_cast<int16_t>((shifted + (shifted >= 0 ? 2048 : -2048)) / 4096);
  }

  MergeHorizontalPass(ink, horizontal, width, height, kernel_x, radius_x, tap_row_offset);

  uint16_t global_peak = 0;
  for (int y = 0; y < height; ++y) {
    uint8_t* row = map + static_cast<size_t>(y) * width;
    uint16_t peak = 0;
    for (int x = 0; x < width; ++x) {
      const uint16_t value_q15 =
          MergeVerticalAt(horizontal, width, height, x, y, kernel_y, radius_y);
      // Q15 -> 8 bit. A 1/256 quantisation of full scale is far finer than a
      // 35% threshold needs.
      const uint8_t value_u8 = static_cast<uint8_t>(value_q15 >> 7);
      row[x] = value_u8;
      if (value_u8 > peak) peak = value_u8;
    }
    row_peak[y] = peak;
    if (peak > global_peak) global_peak = peak;
  }

  if (global_peak == 0) {
    std::memset(map, 0, static_cast<size_t>(width) * height);
    return true;
  }

  // Dilate the row peaks vertically so a whole text line shares one reference
  // level, then floor them at a quarter of the frame peak so blank rows cannot
  // amplify noise into a word.
  const int peak_window = radius_y + std::max(1, static_cast<int>(median_height_x2) / 4);
  const uint16_t floor_peak = static_cast<uint16_t>(global_peak / 4);
  const uint32_t threshold_pct = std::max<uint32_t>(1U, config.word_threshold_pct);
  for (int y = 0; y < height; ++y) {
    const int y0 = std::max(0, y - peak_window);
    const int y1 = std::min(height - 1, y + peak_window);
    uint16_t peak = 0;
    for (int s = y0; s <= y1; ++s) peak = std::max(peak, row_peak[s]);
    const uint32_t reference = std::max(peak, floor_peak);
    uint8_t* row = map + static_cast<size_t>(y) * width;
    for (int x = 0; x < width; ++x) {
      row[x] = (static_cast<uint32_t>(row[x]) * 100U > reference * threshold_pct) ? 1 : 0;
    }
  }
  return true;
}

// ---------------------------------------------------------------------------
// Gap analysis
// ---------------------------------------------------------------------------

int OtsuThreshold(const uint32_t* histogram, int bins) {
  uint64_t total = 0;
  uint64_t sum = 0;
  for (int i = 0; i < bins; ++i) {
    total += histogram[i];
    sum += static_cast<uint64_t>(i) * histogram[i];
  }
  if (total == 0) return 0;

  uint64_t weight_background = 0;
  uint64_t sum_background = 0;
  uint64_t best_variance = 0;
  int best_threshold = 0;
  for (int t = 0; t < bins; ++t) {
    weight_background += histogram[t];
    sum_background += static_cast<uint64_t>(t) * histogram[t];
    if (weight_background == 0) continue;
    const uint64_t weight_foreground = total - weight_background;
    if (weight_foreground == 0) break;
    // sum_b*Wf - (sum-sum_b)*Wb == Wb*Wf*(mean_b - mean_f).
    const uint64_t left = sum_background * weight_foreground;
    const uint64_t right = (sum - sum_background) * weight_background;
    const uint64_t difference = left > right ? left - right : right - left;
    // Scale before squaring so the product cannot overflow 64 bits. The
    // between-class variance is only ever compared against itself.
    const uint64_t scaled = difference >> 10;
    const uint64_t variance = (scaled * scaled) / (weight_background * weight_foreground);
    if (variance > best_variance) {
      best_variance = variance;
      best_threshold = t;
    }
  }
  return best_threshold;
}

// ---------------------------------------------------------------------------
// Diagnostics and scratch
// ---------------------------------------------------------------------------

void SetDetectError(DetectionResult* result, Stream* log, const char* stage,
                    const char* message) {
  if (result != nullptr) {
    snprintf(result->error, sizeof(result->error), "%s: %s", stage, message);
  }
  if (log != nullptr) {
    log->printf("DETECT stage=%s status=error message=%s\n", stage, message);
  }
}

void LogDetectStage(Stream* log, const char* stage, const char* status) {
  if (log != nullptr) log->printf("DETECT stage=%s status=%s\n", stage, status);
}

struct Scratch {
  uint16_t* horizontal = nullptr;
  uint8_t* ink = nullptr;
  uint8_t* work = nullptr;
  uint32_t* stack = nullptr;
  CharBox* chars = nullptr;
  uint16_t* char_word = nullptr;
  uint16_t* order = nullptr;
  BlobBox* blobs = nullptr;
  int32_t* coord_x = nullptr;
  int32_t* coord_y = nullptr;
  uint16_t* row_peak = nullptr;

  void Release() {
    heap_caps_free(horizontal);
    heap_caps_free(ink);
    heap_caps_free(work);
    heap_caps_free(stack);
    heap_caps_free(chars);
    heap_caps_free(char_word);
    heap_caps_free(order);
    heap_caps_free(blobs);
    heap_caps_free(coord_x);
    heap_caps_free(coord_y);
    heap_caps_free(row_peak);
  }

  bool Ok() const {
    return horizontal && ink && work && stack && chars && char_word && order && blobs &&
           coord_x && coord_y && row_peak;
  }
};

}  // namespace

bool McuWordDetector::Detect(const GrayImage& image, DetectionResult* result, Stream* log) {
  if (result == nullptr) {
    SetDetectError(nullptr, log, "input", "result pointer is null");
    return false;
  }
  std::memset(result, 0, sizeof(*result));
  if (image.pixels == nullptr || image.width == 0 || image.height == 0 ||
      image.width > kDetectorMaxWidth || image.height > kDetectorMaxHeight) {
    SetDetectError(result, log, "input", "invalid grayscale image or dimensions");
    return false;
  }
  LogDetectStage(log, "input", "ok");

  const uint32_t started = micros();
  const int width = image.width;
  const int height = image.height;
  const size_t count = static_cast<size_t>(width) * height;
  const size_t stack_capacity = std::min(count, kComponentStackCapacity);
  const int dec = ClampInt(config_.bg_decimate == 0 ? 4 : config_.bg_decimate, 1, 4);

  Scratch scratch;
  scratch.horizontal = AllocatePsram<uint16_t>(count);
  scratch.ink = AllocatePsram<uint8_t>(count);
  scratch.work = AllocatePsram<uint8_t>(count);
  scratch.stack = AllocatePsram<uint32_t>(stack_capacity);
  scratch.chars = AllocatePsram<CharBox>(kMaxCharBoxes);
  scratch.char_word = AllocatePsram<uint16_t>(kMaxCharBoxes);
  scratch.order = AllocatePsram<uint16_t>(kMaxCharBoxes);
  scratch.blobs = AllocatePsram<BlobBox>(kMaxWordBoxes);
  scratch.coord_x = AllocatePsram<int32_t>(width);
  scratch.coord_y = AllocatePsram<int32_t>(height);
  scratch.row_peak = AllocatePsram<uint16_t>(height);
  if (!scratch.Ok()) {
    scratch.Release();
    SetDetectError(result, log, "alloc", "detector scratch allocation failed");
    return false;
  }
  if (log != nullptr) {
    log->printf("DETECT stage=alloc status=ok pixels=%u stack_entries=%u\n",
                static_cast<unsigned>(count), static_cast<unsigned>(stack_capacity));
  }

  // --- adaptive threshold offset -------------------------------------------
  uint32_t phase = micros();
  uint16_t contrast = 0;
  const uint8_t threshold_c =
      config_.adaptive_threshold_c ? MeasureContrastAndThresholdC(image.pixels, count, &contrast)
                                   : config_.fixed_threshold_c;
  result->contrast = contrast;
  result->threshold_c = threshold_c;
  result->threshold_us = micros() - phase;

  // --- background and ink mask ---------------------------------------------
  phase = micros();
  int bg_radius = kBgBlurRadius;
  if (!BuildInkMask(image.pixels, scratch.ink, scratch.work, scratch.horizontal, width, height,
                    dec, bg_radius, threshold_c, scratch.coord_x, scratch.coord_y)) {
    scratch.Release();
    SetDetectError(result, log, "background_threshold", "background estimation failed");
    return false;
  }
  result->background_us = micros() - phase;
  if (log != nullptr) {
    log->printf(
        "DETECT stage=background_threshold status=ok c=%u contrast=%u radius=%d decimate=%d "
        "us=%u\n",
        threshold_c, contrast, bg_radius, dec, result->background_us);
  }

  // --- character pass -------------------------------------------------------
  phase = micros();
  uint32_t char_height_histogram[kDetectorMaxHeight + 1] = {};
  std::memcpy(scratch.work, scratch.ink, count);
  CharPassResult char_pass = CollectCharComponents(
      scratch.work, scratch.ink, width, height, kCharMinArea, scratch.stack, stack_capacity,
      scratch.chars, kMaxCharBoxes, char_height_histogram, kDetectorMaxHeight + 1);
  uint16_t median_height_x2 = MedianHeightX2FromHistogram(
      char_height_histogram, kDetectorMaxHeight + 1, char_pass.height_count);

  // --- background window retry ----------------------------------------------
  // A fixed 31 px background window assumes ~14 px characters. The close-range
  // camera path produces much larger glyphs, and then the background is
  // estimated from inside the strokes themselves, so thick stroke interiors
  // threshold as paper. Re-run once with a window scaled to the measured text.
  if (config_.adaptive_bg_radius && median_height_x2 > 0) {
    const int measured_height = std::max(1, median_height_x2 / 2);
    const int wanted = ClampInt((22 * measured_height) / 10, 16, dec * kMaxKernelRadius);
    if (wanted > bg_radius + 8 || wanted < bg_radius - 8) {
      bg_radius = wanted;
      const uint32_t retry_started = micros();
      if (!BuildInkMask(image.pixels, scratch.ink, scratch.work, scratch.horizontal, width,
                        height, dec, bg_radius, threshold_c, scratch.coord_x, scratch.coord_y)) {
        scratch.Release();
        SetDetectError(result, log, "background_threshold", "background retry failed");
        return false;
      }
      result->background_us += micros() - retry_started;

      std::memset(char_height_histogram, 0, sizeof(char_height_histogram));
      std::memcpy(scratch.work, scratch.ink, count);
      char_pass = CollectCharComponents(scratch.work, scratch.ink, width, height, kCharMinArea,
                                        scratch.stack, stack_capacity, scratch.chars,
                                        kMaxCharBoxes, char_height_histogram,
                                        kDetectorMaxHeight + 1);
      median_height_x2 = MedianHeightX2FromHistogram(
          char_height_histogram, kDetectorMaxHeight + 1, char_pass.height_count);
      if (log != nullptr) {
        log->printf("DETECT stage=background_retry status=ok radius=%d median_height_x2=%u\n",
                    bg_radius, median_height_x2);
      }
    }
  }
  result->bg_radius = static_cast<uint8_t>(std::min(bg_radius, 255));
  result->median_char_height_x2 = median_height_x2;
  result->component_stack_overflow = char_pass.overflow;
  result->char_box_overflow = char_pass.box_overflow;
  result->character_pass_us = micros() - phase;
  if (log != nullptr) {
    log->printf("DETECT stage=character_pass status=%s chars=%u median_height_x2=%u us=%u\n",
                char_pass.overflow ? "warning" : "ok", static_cast<unsigned>(char_pass.count),
                median_height_x2, result->character_pass_us);
  }

  if (median_height_x2 == 0 || char_pass.count == 0) {
    scratch.Release();
    result->total_us = micros() - started;
    LogDetectStage(log, "word_merge", "skipped_no_characters");
    LogDetectStage(log, "word_components", "skipped_no_characters");
    if (log != nullptr) {
      log->printf("DETECT stage=done status=ok boxes=0 total_us=%u\n", result->total_us);
    }
    return true;
  }

  const int char_height = std::max(1, median_height_x2 / 2);

  // --- remove page rules, borders and figure edges --------------------------
  // One oversized component - a table rule, a page border, the edge of a
  // photograph - survives the merge blur and swallows every word it touches.
  // Erasing it by re-flooding from its stored seed is exact, unlike erasing its
  // bounding box, which for a full-page border would erase the whole page.
  size_t kept_chars = char_pass.count;
  if (config_.drop_rules) {
    const int max_height = 4 * char_height;
    const int max_width = std::max(8 * char_height, (8 * width) / 10);
    kept_chars = 0;
    for (size_t i = 0; i < char_pass.count; ++i) {
      const CharBox& box = scratch.chars[i];
      if ((box.y2 - box.y1 + 1) > max_height || (box.x2 - box.x1 + 1) > max_width) {
        EraseComponent(scratch.ink, width, height, box.seed, scratch.stack, stack_capacity);
        ++result->rules_removed;
        continue;
      }
      scratch.chars[kept_chars++] = box;
    }
  }
  result->char_count = static_cast<uint16_t>(kept_chars);
  if (kept_chars == 0) {
    scratch.Release();
    result->total_us = micros() - started;
    LogDetectStage(log, "word_merge", "skipped_no_characters");
    if (log != nullptr) {
      log->printf("DETECT stage=done status=ok boxes=0 total_us=%u\n", result->total_us);
    }
    return true;
  }

  // --- skew -----------------------------------------------------------------
  int16_t slope_q12 = 0;
  if (config_.enable_skew) {
    slope_q12 = EstimateSkewSlopeQ12(scratch.chars, kept_chars, char_height);
    // Ignore sub-degree tilt; it does not justify the sheared memory access.
    if (slope_q12 > -84 && slope_q12 < 84) slope_q12 = 0;
  }
  result->skew_slope_q12 = slope_q12;

  // --- word merge -----------------------------------------------------------
  // The merge is only a grouping device: every returned box edge now comes from
  // full-resolution character components, so the blur may run on a decimated
  // mask. Cost falls with the square of the factor, which is what keeps large
  // close-range glyphs affordable. Decimation biases towards over-merging, and
  // the gap split below undoes that; it never splits a word that belongs
  // together.
  phase = micros();
  const int mdec = ClampInt(char_height / 8, 1, 4);
  const int merge_width = CeilDivPositive(width, mdec);
  const int merge_height = CeilDivPositive(height, mdec);
  const size_t merge_count = static_cast<size_t>(merge_width) * merge_height;
  const uint16_t merge_height_x2 =
      static_cast<uint16_t>(std::max(2, median_height_x2 / mdec));

  const uint8_t* merge_source = scratch.ink;
  uint8_t* merge_map = scratch.work;
  if (mdec > 1) {
    // Both buffers live in `work`: merge_count <= count/4 for mdec >= 2.
    uint8_t* ink_small = scratch.work;
    merge_map = scratch.work + merge_count;
    DecimateInkMax(scratch.ink, width, height, mdec, ink_small, merge_width, merge_height);
    merge_source = ink_small;
  }
  if (!BuildWordMask(merge_source, merge_map, scratch.horizontal, merge_width, merge_height,
                     merge_height_x2, slope_q12, config_, scratch.row_peak)) {
    scratch.Release();
    SetDetectError(result, log, "word_merge", "adaptive word Gaussian failed");
    return false;
  }
  result->word_merge_us = micros() - phase;
  if (log != nullptr) {
    log->printf("DETECT stage=word_merge status=ok slope_q12=%d merge_decimate=%d us=%u\n",
                slope_q12, mdec, result->word_merge_us);
  }

  // --- word blobs -----------------------------------------------------------
  phase = micros();
  const uint32_t h2 = median_height_x2;
  // 0.3*h^2 rather than 0.6*h^2: short dictionary words ("a", "I", "of") are
  // exactly the ones a learner looks up. Blobs holding no character component
  // are dropped outright below, which is a stronger noise filter than area.
  const uint32_t min_word_area = std::max<uint32_t>(12U, (3U * h2 * h2) / 40U);
  const uint32_t min_blob_area =
      std::max<uint32_t>(3U, min_word_area / static_cast<uint32_t>(mdec * mdec));
  const size_t blob_count =
      CollectBlobs(merge_map, merge_width, merge_height, min_blob_area, scratch.stack,
                   std::min(merge_count, stack_capacity), scratch.blobs, kMaxWordBoxes,
                   &result->component_stack_overflow, &result->box_capacity_reached);
  result->word_components_us = micros() - phase;

  // --- refine, split, pad ---------------------------------------------------
  phase = micros();
  constexpr uint16_t kNoWord = 0xFFFF;
  for (size_t i = 0; i < kept_chars; ++i) {
    const int cx = CharCenterX(scratch.chars[i]);
    const int cy = CharCenterY(scratch.chars[i]);
    uint16_t owner = kNoWord;
    for (size_t w = 0; w < blob_count; ++w) {
      const BlobBox& blob = scratch.blobs[w];
      // Blob coordinates are in merge space; expand to full resolution.
      const int bx1 = blob.x1 * mdec;
      const int by1 = blob.y1 * mdec;
      const int bx2 = blob.x2 * mdec + (mdec - 1);
      const int by2 = blob.y2 * mdec + (mdec - 1);
      if (cx >= bx1 && cx <= bx2 && cy >= by1 && cy <= by2) {
        owner = static_cast<uint16_t>(w);
        break;
      }
    }
    scratch.char_word[i] = owner;
    scratch.order[i] = static_cast<uint16_t>(i);
  }

  // Group characters by blob, left to right inside each blob. kNoWord sorts
  // last, so every blob's members form one contiguous run.
  const CharBox* chars = scratch.chars;
  const uint16_t* char_word = scratch.char_word;
  std::sort(scratch.order, scratch.order + kept_chars,
            [chars, char_word](uint16_t a, uint16_t b) {
              if (char_word[a] != char_word[b]) return char_word[a] < char_word[b];
              return chars[a].x1 < chars[b].x1;
            });

  // Gap statistics across every blob. Printed text has a bimodal gap
  // distribution - inter-letter versus inter-word - so Otsu adapts the split
  // point to this frame's actual letter spacing instead of a fixed constant.
  uint32_t gap_histogram[256] = {};
  for (size_t i = 0; i + 1 < kept_chars; ++i) {
    const uint16_t a = scratch.order[i];
    const uint16_t b = scratch.order[i + 1];
    if (char_word[a] == kNoWord || char_word[a] != char_word[b]) continue;
    const int gap = static_cast<int>(chars[b].x1) - static_cast<int>(chars[a].x2) - 1;
    ++gap_histogram[ClampInt(gap, 0, 255)];
  }
  const int otsu_gap = config_.enable_gap_split ? OtsuThreshold(gap_histogram, 256) : 255;
  const int absolute_gap =
      std::max(2, (static_cast<int>(config_.split_gap_pct) * char_height) / 100);
  // Otsu adapts the split point to this frame's letter spacing, but it is a
  // single threshold over every line in the frame. On a dense page - or one
  // mixing body text with a heading - it can settle above the real inter-word
  // gap, and then no blob is ever cut and two words share one box. Capping it
  // bounds that failure: a printed word gap never exceeds ~0.9 * x-height, so
  // a threshold above 2 * absolute_gap cannot be separating words.
  const int otsu_cap =
      (absolute_gap * static_cast<int>(config_.split_gap_otsu_cap_x10)) / 10;
  const int split_gap = std::max(absolute_gap, std::min(otsu_gap, otsu_cap));

  const int pad_x =
      std::max(2, (static_cast<int>(config_.pad_x_pct) * char_height + 50) / 100);
  const int pad_y =
      std::max(2, (static_cast<int>(config_.pad_y_pct) * char_height + 50) / 100);
  const int margin = config_.border_margin;

  // A single component shorter than this is punctuation: every letter reaches
  // at least x-height, which sits well above it, while a comma or an
  // apostrophe sits well below.
  const int punct_max_height =
      (static_cast<int>(config_.punct_max_height_pct) * char_height) / 100;

  size_t out_count = 0;
  auto emit = [&](int ink_x1, int ink_y1, int ink_x2, int ink_y2, int baseline,
                  uint32_t area, uint16_t char_count, bool from_split, bool unrefined) {
    if (out_count >= kMaxWordBoxes) {
      result->box_capacity_reached = true;
      return;
    }
    WordBox box{};
    box.ink_x1 = static_cast<uint16_t>(ClampInt(ink_x1, 0, width - 1));
    box.ink_y1 = static_cast<uint16_t>(ClampInt(ink_y1, 0, height - 1));
    box.ink_x2 = static_cast<uint16_t>(ClampInt(ink_x2, 0, width - 1));
    box.ink_y2 = static_cast<uint16_t>(ClampInt(ink_y2, 0, height - 1));
    box.baseline_y = static_cast<uint16_t>(
        ClampInt(baseline, box.ink_y1, box.ink_y2));

    const int padded_x1 = static_cast<int>(box.ink_x1) - pad_x;
    const int padded_y1 = static_cast<int>(box.ink_y1) - pad_y;
    const int padded_x2 = static_cast<int>(box.ink_x2) + pad_x;
    const int padded_y2 = static_cast<int>(box.ink_y2) + pad_y;
    box.x1 = static_cast<uint16_t>(ClampInt(padded_x1, 0, width - 1));
    box.y1 = static_cast<uint16_t>(ClampInt(padded_y1, 0, height - 1));
    box.x2 = static_cast<uint16_t>(ClampInt(padded_x2, 0, width - 1));
    box.y2 = static_cast<uint16_t>(ClampInt(padded_y2, 0, height - 1));

    // Truncation is judged on the ink, never on the padded box: a complete word
    // that merely sits near the margin must stay usable for dictionary lookup.
    uint8_t flags = 0;
    if (box.ink_x1 <= margin) flags |= kWordFlagTruncLeft;
    if (box.ink_x2 >= width - 1 - margin) flags |= kWordFlagTruncRight;
    if (box.ink_y1 <= margin) flags |= kWordFlagTruncTop;
    if (box.ink_y2 >= height - 1 - margin) flags |= kWordFlagTruncBottom;
    if ((flags & kWordFlagTruncAny) == 0 &&
        (padded_x1 < 0 || padded_y1 < 0 || padded_x2 > width - 1 || padded_y2 > height - 1)) {
      flags |= kWordFlagPadClipped;
    }
    if (from_split) flags |= kWordFlagSplit;
    if (unrefined) flags |= kWordFlagUnrefined;

    // Punctuation and specks: a lone comma, apostrophe, hyphen or a surviving
    // fleck of noise. They used to be labelled complete words and sent to the
    // recognizer, which costs a full inference and returns noise.
    const int ink_height = box.ink_y2 - box.ink_y1 + 1;
    if (!unrefined && char_count >= 1 && char_count <= config_.punct_max_components &&
        ink_height < punct_max_height) {
      flags |= kWordFlagPunctuation;
    }

    if (config_.drop_truncated && (flags & kWordFlagTruncAny) != 0) return;

    box.area = area;
    box.char_count = char_count;
    box.flags = flags;
    box.touches_edge = (flags & kWordFlagTruncAny) != 0;
    result->boxes[out_count++] = box;
    if (box.touches_edge) ++result->truncated_count;
    if ((flags & kWordFlagPunctuation) != 0) ++result->punctuation_count;
    if (box.recognizable()) ++result->recognizable_count;
    if (from_split) ++result->split_count;
  };

  size_t cursor = 0;
  for (size_t w = 0; w < blob_count; ++w) {
    while (cursor < kept_chars && char_word[scratch.order[cursor]] < w) ++cursor;
    const size_t run_begin = cursor;
    size_t run_end = cursor;
    while (run_end < kept_chars && char_word[scratch.order[run_end]] == w) ++run_end;
    cursor = run_end;

    const size_t members = run_end - run_begin;
    if (members == 0) {
      // Normally speckle or a fragment of an erased rule, so it is dropped.
      // If the character table overflowed the blob may still be real, in which
      // case fall back to the blurred extent and mark the box unrefined.
      if (result->char_box_overflow) {
        const BlobBox& blob = scratch.blobs[w];
        const int fallback_bottom = blob.y2 * mdec + (mdec - 1);
        emit(blob.x1 * mdec, blob.y1 * mdec, blob.x2 * mdec + (mdec - 1),
             fallback_bottom, fallback_bottom, blob.area, 0, false, true);
      }
      continue;
    }

    // Median internal gap of this blob, the relative guard for the split.
    int median_gap = 0;
    if (members > 2) {
      uint32_t local_histogram[256] = {};
      for (size_t i = run_begin; i + 1 < run_end; ++i) {
        const int gap = static_cast<int>(chars[scratch.order[i + 1]].x1) -
                        static_cast<int>(chars[scratch.order[i]].x2) - 1;
        ++local_histogram[ClampInt(gap, 0, 255)];
      }
      const uint32_t total = static_cast<uint32_t>(members - 1);
      uint32_t seen = 0;
      for (int g = 0; g < 256; ++g) {
        seen += local_histogram[g];
        if (seen * 2U >= total) {
          median_gap = g;
          break;
        }
      }
    }
    // A blob is only cut where the gap is both absolutely wide and clearly
    // wider than this blob's own letter spacing. Letterspaced display text
    // therefore survives intact.
    const int relative_gap =
        std::max(1, (median_gap * static_cast<int>(config_.split_gap_ratio_x10)) / 10);

    size_t segment_begin = run_begin;
    for (size_t i = run_begin; i < run_end; ++i) {
      const bool last = (i + 1 == run_end);
      bool cut = last;
      if (!last && config_.enable_gap_split) {
        const int gap = static_cast<int>(chars[scratch.order[i + 1]].x1) -
                        static_cast<int>(chars[scratch.order[i]].x2) - 1;
        if (gap >= split_gap && gap >= relative_gap) cut = true;
      }
      if (!cut) continue;

      int x1 = width;
      int y1 = height;
      int x2 = 0;
      int y2 = 0;
      uint32_t area = 0;
      // Bottom edges of this word's components, for the baseline median. A
      // word never has this many glyphs; the bound only keeps the buffer fixed.
      constexpr size_t kMaxBaselineSamples = 64;
      uint16_t bottoms[kMaxBaselineSamples];
      size_t bottom_count = 0;
      for (size_t k = segment_begin; k <= i; ++k) {
        const CharBox& cb = chars[scratch.order[k]];
        x1 = std::min<int>(x1, cb.x1);
        y1 = std::min<int>(y1, cb.y1);
        x2 = std::max<int>(x2, cb.x2);
        y2 = std::max<int>(y2, cb.y2);
        area += cb.area;
        if (bottom_count < kMaxBaselineSamples) bottoms[bottom_count++] = cb.y2;
      }
      // Median bottom edge = baseline. Descenders (g, j, p, q, y) and the odd
      // comma sit below it but are always a minority of a word's glyphs, so the
      // median is not dragged down the way a max or a mean would be.
      int baseline = y2;
      if (bottom_count > 0) {
        std::nth_element(bottoms, bottoms + bottom_count / 2, bottoms + bottom_count);
        baseline = bottoms[bottom_count / 2];
      }
      const bool from_split = (segment_begin != run_begin) || !last;
      emit(x1, y1, x2, y2, baseline, area, static_cast<uint16_t>(i - segment_begin + 1),
           from_split, false);
      segment_begin = i + 1;
    }
  }

  result->count = out_count;
  result->refine_us = micros() - phase;

  // --- reading order --------------------------------------------------------
  // Group into text lines on the ink centre with a 0.7*h tolerance, which
  // survives the differing box heights that ascenders and descenders produce.
  std::sort(result->boxes, result->boxes + result->count,
            [](const WordBox& a, const WordBox& b) {
              const int ay = (a.ink_y1 + a.ink_y2) >> 1;
              const int by = (b.ink_y1 + b.ink_y2) >> 1;
              if (ay != by) return ay < by;
              return a.ink_x1 < b.ink_x1;
            });
  if (result->count > 1) {
    const int tolerance = std::max(2, (7 * char_height) / 10);
    uint16_t line_id[kMaxWordBoxes];
    uint16_t line = 0;
    int reference = (result->boxes[0].ink_y1 + result->boxes[0].ink_y2) >> 1;
    for (size_t i = 0; i < result->count; ++i) {
      const int center = (result->boxes[i].ink_y1 + result->boxes[i].ink_y2) >> 1;
      if (center - reference > tolerance) {
        ++line;
        reference = center;
      }
      line_id[i] = line;
    }
    for (size_t i = 1; i < result->count; ++i) {
      const WordBox box = result->boxes[i];
      const uint16_t id = line_id[i];
      size_t j = i;
      while (j > 0 && (line_id[j - 1] > id ||
                       (line_id[j - 1] == id && result->boxes[j - 1].ink_x1 > box.ink_x1))) {
        result->boxes[j] = result->boxes[j - 1];
        line_id[j] = line_id[j - 1];
        --j;
      }
      result->boxes[j] = box;
      line_id[j] = id;
    }
  }

  if (log != nullptr) {
    log->printf("DETECT stage=word_components status=%s blobs=%u boxes=%u split=%u "
                "truncated=%u rules=%u us=%u refine_us=%u\n",
                result->component_stack_overflow ? "warning" : "ok",
                static_cast<unsigned>(blob_count), static_cast<unsigned>(result->count),
                result->split_count, result->truncated_count, result->rules_removed,
                result->word_components_us, result->refine_us);
  }

  scratch.Release();
  result->total_us = micros() - started;
  if (log != nullptr) {
    log->printf("DETECT stage=done status=ok boxes=%u total_us=%u stack_overflow=%u "
                "char_overflow=%u capacity=%u\n",
                static_cast<unsigned>(result->count), result->total_us,
                result->component_stack_overflow ? 1U : 0U, result->char_box_overflow ? 1U : 0U,
                result->box_capacity_reached ? 1U : 0U);
  }
  return true;
}

}  // namespace ocr_demo
